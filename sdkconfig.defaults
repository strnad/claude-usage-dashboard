## sdkconfig.defaults
```kconfig
CONFIG_IDF_TARGET="esp32c6"

# Custom partition table (factory app = 6M)
CONFIG_PARTITION_TABLE_CUSTOM=y
CONFIG_PARTITION_TABLE_CUSTOM_FILENAME="partitions.csv"
CONFIG_PARTITION_TABLE_FILENAME="partitions.csv"

# 8 MB flash on this board
CONFIG_ESPTOOLPY_FLASHSIZE_8MB=y
CONFIG_ESPTOOLPY_FLASHSIZE="8MB"

# LVGL 8.4 — color & fonts
CONFIG_LV_COLOR_16_SWAP=y
CONFIG_LV_FONT_MONTSERRAT_12=y
CONFIG_LV_FONT_MONTSERRAT_14=y
CONFIG_LV_FONT_MONTSERRAT_16=y
CONFIG_LV_FONT_MONTSERRAT_20=y
CONFIG_LV_FONT_MONTSERRAT_24=y
CONFIG_LV_FONT_MONTSERRAT_32=y
CONFIG_LV_MEM_SIZE_KILOBYTES=64

# HTTPS via mbedTLS cert bundle (Anthropic API)
CONFIG_MBEDTLS_CERTIFICATE_BUNDLE=y
CONFIG_MBEDTLS_CERTIFICATE_BUNDLE_DEFAULT_FULL=y

# HTTP client / server tuning
CONFIG_HTTPD_MAX_REQ_HDR_LEN=2048
CONFIG_HTTPD_MAX_URI_LEN=2048
CONFIG_LWIP_MAX_SOCKETS=10
CONFIG_ESP_HTTPS_OTA_DECRYPT_CB=n

# Larger heap for HTTPS handshake on ESP32-C6
CONFIG_ESP_MAIN_TASK_STACK_SIZE=8192
CONFIG_ESP_TIMER_TASK_STACK_SIZE=4096

# SNTP — for time-based features
CONFIG_LWIP_SNTP_MAX_SERVERS=2

# Newlib — for time_t / tm
CONFIG_NEWLIB_NANO_FORMAT=n
```
